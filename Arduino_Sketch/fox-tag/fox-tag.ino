/*
 * https://github.com/cpgmoore/fox-tag
 * 
 * Date:    2019.05
 * Author:  cpgmoore
 * License: MIT License
 * 
 * Reconfigurable radio beacon for fox hunting/radio location activities
 * Written for Arduino Nano & ADF4351 evaluation board
 * Writes ascii messages in the radio spectrum for quick positive ID of fox signal
 * Example tool for observation of message: RTLSDR/HackRF + GQRX
 * 
 * Disclaimer: 
 * For use only by persons competent in the operation of radio transmission equipment.
 * Use and misuse may be in violation of international and domestic telecommunications regulations.
 * Legal penalties may apply.
 * RF bandpass filtering is required to keep spurious emissions to within limits.
 * If in doubt, read https://en.wikipedia.org/wiki/ITU_Radio_Regulations
 *    and follow the rules of your regional radio regulatory agency. 
 * The author of this code takes no responsibility for anything you do.   
 * 
 * Instructions:
 * 1) Wire as per below wiring diagram
 * 2) Install ADF4351 library from https://github.com/dfannin/adf4351
 * 3) Install BigNumber library from https://github.com/nickgammon/BigNumber
 * 3) Modify ADF4351 library file adf4351.h, PIN_SS 10, to reflect default hardware SPI in wiring diagram
 * 4) Use appropriate SAW filter on SMA output before feeding antenna
 * 5) Upload, green "Lock Flag" LED will light up on PLL module if all is well
 * 
 * Wiring diagram:
 * AD4351_Eval                   Arduino_Nano
 *  ______                    ___________________
 * |  CLK |-----o--------2k--|  D13 (SPI SCK)    |
 * |      |     |            |                   |
 * |  DAT |--------o-----2k--|  D11 (SPI MOSI)   |
 * |      |     |  |         |                   |
 * |  LE  |-----------o--2k--|  D10 (SPI SS_BAR) |
 * |      |     |  |  |      |                   |
 * |  3.3v|--o  |  |  |      |                   |
 * |      |  |  3k 3k 3k     |                   |
 * |  CE  |--o  |  |  |      |                   |
 * |      |     |  |  |      |                   |
 * |  5V- |-----o--o--o------|  GND              |
 * |      |                  |                   |
 * |  5V+ |------------------|  5V               |
 * |______|                  |___________________|
 */

#include <Arduino.h>
#include <BigNumber.h>
#include <adf4351.h>

#define SPI_SPEED 1000000UL
ADF4351  vfo(PIN_SS, SPI_MODE0, SPI_SPEED  , MSBFIRST) ;
//SPI pins used are default hardware SPI port Digital 10/11/12/13

//from https://github.com/dhepper/font8x8/blob/master/font8x8_basic.h
//Modified to explicitly store in flash mem
const static uint8_t font8x8_basic[128][8] PROGMEM= {
    { 0x00, 0x00, 0x00, 0x00, 0x00, 0x00, 0x00, 0x00},   // U+0000 (nul)
    { 0x00, 0x00, 0x00, 0x00, 0x00, 0x00, 0x00, 0x00},   // U+0001
    { 0x00, 0x00, 0x00, 0x00, 0x00, 0x00, 0x00, 0x00},   // U+0002
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    { 0x00, 0x00, 0x00, 0x00, 0x00, 0x00, 0x00, 0x00}    // U+007F
};


void setup()
{
  /*!
     setup the chip (for a 25 mhz ref freq)
     most of these are defaults
  */
  vfo.pwrlevel = 0 ; ///< sets to -4 dBm output
  vfo.RD2refdouble = 0 ; ///< ref doubler off
  vfo.RD1Rdiv2 = 0 ;   ///< ref divider off
  vfo.ClkDiv = 150 ;
  vfo.BandSelClock = 80 ;
  vfo.RCounter = 1 ;  ///< R counter to 1 (no division)
  vfo.ChanStep = steps[2] ;  ///< set to 10 kHz steps

  /*!
     sets the reference frequency to 25 Mhz
  */
  unsigned long refFreq = 25000000;
  vfo.setrf(refFreq);

  /*!
     initialize the chip
  */
  vfo.init() ;
}

void loop()
{

  /*
   * https://en.wikipedia.org/wiki/ISM_band
   * 
   * ADF4351 PLL module datasheet
   * https://www.analog.com/media/en/technical-documentation/data-sheets/ADF4351.pdf
   * 
   * The PLL module VCO has a fundamental sine wave out of 2200MHz to 4400
   * and is divided using fractional PLL techniques to create frequencies lower than this
   * 
   * The output is not a spectrally pure sine wave, and MUST be bandpass filtered prior to the antenna
   * Examples of suitable SAW filters:
   * -AFS434S3 (433.92 MHz)
   * -SF2049E  (915 MHz)
   * -SF2124E  (2450 MHz)
   */
   
  //unsigned long kHz_fC  = 433920; //433.92 MHz
  //unsigned long kHz_fC  = 915000; //915 MHz
  unsigned long kHz_fC    = 2450000; //2450 MHz

  //The below default settings give 100kHz BW usage for 8 pixel font
  unsigned long kHz_pix0        = 20;     //Distance between carrier and first pixel
  unsigned long kHz_pixInterval = 10;     //Ideal for FFT 2.4kHz resolution BW
  uint8_t font_pixels_h = 8;
  uint8_t font_pixels_w = 8;
  uint8_t line_repeats = 1; //increase this from 1 to 2 or 3 to repeat the number of times a column is printed
  
  while(true)
  {

    char message[] = "cpgmoore/fox-tag  ";
    
    for(uint8_t message_i = 0; message_i < (sizeof(message)-1); ++message_i)
    {
      uint32_t ascii_i = message[message_i];

      //Bring in the whole dot matrix font data for the character
      //in case we wish to transpose/rotate the character
      uint8_t font_char[font_pixels_h];
      for(uint32_t pix_row_i = 0; pix_row_i < font_pixels_h; ++pix_row_i)
      {
        uint32_t flash_address = &(font8x8_basic[ascii_i][pix_row_i]);
        font_char[pix_row_i] = pgm_read_byte(flash_address);    
      }
      
      for(uint8_t pix_col_i = 0; pix_col_i < font_pixels_w; ++pix_col_i)
      {
        //Repeat the painting of one line for a specified number of times
        for(uint8_t line_repeat = 0; line_repeat < line_repeats; ++line_repeat)
        {
                //now scan this line at frequency intervals
                for(uint8_t pix_row_i = 0; pix_row_i < font_pixels_h; ++pix_row_i)
                { 
                  uint8_t mask = 0x01 << pix_col_i;

                  uint8_t dot_line_byte = font_char[pix_row_i];
                  if((dot_line_byte & mask) != 0)
                  {
                    //Then pixel is on
                    //vfo.enable(); //Requires pin Chip enable
                    
                    //paint a particular frequency offset from carrier
                    vfo.setf((kHz_fC+kHz_pix0+(unsigned long)pix_row_i*kHz_pixInterval)*1000UL);
                  }
                  else
                  {
                    //Then pixel is off

                    //vfo.disable(); //Requires pin Chip enable

                    //Return to painting the carrier
                    vfo.setf((kHz_fC)*1000UL);
                  }
                  delay(40); //Ideal for 15 FPS, timespan auto 
                  //delay(30); //Ideal for 60 FPS, timespan 1 minute
                }
        }
      }
      //End of this character
    }
    //End of message 
  }
  //Repeat forever
}
